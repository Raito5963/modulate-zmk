## config/boards/shields/modulate/Kconfig.defconfig
```kconfig
if SHIELD_MODULATE_LEFT

config ZMK_KEYBOARD_NAME
    string
    default "Modulate"

config ZMK_SPLIT_BLE_ROLE_CENTRAL
    bool
    default y

endif

if SHIELD_MODULATE_LEFT || SHIELD_MODULATE_RIGHT

config ZMK_SPLIT
    bool
    default y

endif
```

## zmk-config/boards/shields/modulate/Kconfig.shield
```kconfig
config SHIELD_MODULATE_LEFT
        def_bool $(shields_list_contains,modulate_left)

config SHIELD_MODULATE_RIGHT
        def_bool $(shields_list_contains,modulate _right)
```
