#include "ycorne.dtsi"

&default_transform {
        col-offset = <6>;
};

&kscan0 {
        col-gpios
                = <&gpio0 9 GPIO_ACTIVE_HIGH>
                , <&xiao_ble 10 GPIO_ACTIVE_HIGH>
                , <&xiao_ble 9 GPIO_ACTIVE_HIGH>
                , <&xiao_ble 8 GPIO_ACTIVE_HIGH>
                , <&xiao_ble 7 GPIO_ACTIVE_HIGH>
                , <&xiao_ble 6 GPIO_ACTIVE_HIGH>
                ;
};